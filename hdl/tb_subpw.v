// =============================================================================
// MatshitaPico -- Solid-state CD-ROM drive replacement for the Commodore CDTV
// Copyright (c) 2026 Nicola Avanzi (na103)
// Licensed under Creative Commons Attribution 4.0 International (CC BY 4.0).
// See LICENSE.
// =============================================================================
// Testbench for the CD+G subcode burst engine. Models the Pico PIO (subpw_tx)
// that presents the 8 bits of each frame on rp_subq, and the motherboard that
// bursts 8 async SCCK pulses to shift SBCP out. Checks byte integrity, EFFK/SCOR
// timing, and clean recovery after a PIO stall.
`timescale 1ns/1ps
module tb_subpw;
    reg c16m = 0;
    always #29.5265 c16m = ~c16m;      // 16.9344 MHz

    reg reset_n = 0;
    reg scck = 0;                      // generated by the host model
    reg subq = 0;                      // generated by the PIO model

    wire [7:0] db, rp_d;
    wire drq, n_sten, n_stch, n_ihac, n_xaen, dten, db_dir;
    wire c16m_o, adata, alrck, adsck, sbcp, scor, effk, empasis;
    wire cmd_stb, byte_req, chan, bclk_o, lrck_o, fsync;
    wire vfd_sck, vfd_sdata;

    MatshitaPico_top dut (
        .c16m_osc(c16m),
        .cn9_db(db), .cn9_reset(reset_n),
        .cn9_n_hwr(1'b1), .cn9_n_hrd(1'b1), .cn9_n_cmd(1'b1), .cn9_enable(1'b0),
        .cn9_n_xaen(n_xaen), .cn9_dten(dten), .cn9_drq(drq), .cn9_n_sten(n_sten),
        .cn9_n_stch(n_stch), .cn9_n_ihac(n_ihac), .cn9_db_dir(db_dir),
        .cn9_c16m(c16m_o), .cn9_data(adata), .cn9_lrck(alrck), .cn9_dsck(adsck),
        .cn9_scck(scck), .cn9_sbcp(sbcp), .cn9_scor(scor), .cn9_effk(effk),
        .cn9_empasis(empasis),
        .cn26_sck(vfd_sck), .cn26_sdata(vfd_sdata),
        .rp_d(rp_d), .rp_cmd_stb(cmd_stb), .rp_byte_req(byte_req), .rp_chan(chan),
        .rp_byte_vld(1'b0), .rp_st_avail(1'b0), .rp_dat_avail(1'b0),
        .rp_stch_req(1'b0),
        .rp_audio_data(1'b0), .rp_subq(subq), .rp_empasis(1'b0),
        .rp_bclk(bclk_o), .rp_lrck(lrck_o), .rp_frame_sync(fsync)
    );

    integer errors = 0;

    // data pattern (arbitrary bytes, including MSB set)
    function [7:0] pat(input integer blk, input integer k);
        pat = (blk * 31 + k * 7 + 3) & 8'hFF;
    endfunction

    // "expected" queue: push at transmit, pop at burst
    reg [7:0] expq [0:255];
    integer   exp_wr = 0, exp_rd = 0;
    integer   checked = 0;

    // PIO model (subpw_tx): present the 8 bits of a byte across f6 1..4
    task send_byte(input [7:0] b);
        integer i;
        begin
            for (i = 7; i >= 0; i = i - 1) begin
                #60 subq = b[i];
                if (i % 2 == 1) @(negedge lrck_o);
                else            @(posedge lrck_o);
            end
        end
    endtask

    reg  do_stall = 0;
    integer blkno = 0;

    // PIO stream: resync on SCOR, then transmit 98 bytes/block
    initial begin : pio_model
        integer k;
        reg [7:0] b;
        @(posedge reset_n);
        forever begin : stream
            @(negedge fsync); @(posedge fsync);
            @(negedge lrck_o); @(posedge lrck_o);
            k = 0;
            forever begin
                if (k < 96)      begin b = pat(blkno, k); expq[exp_wr % 256] = b; exp_wr = exp_wr + 1; end
                else if (k == 96) begin b = 8'hFF;        expq[exp_wr % 256] = b; exp_wr = exp_wr + 1; end
                else              b = 8'h00;
                send_byte(b);
                @(negedge lrck_o); @(posedge lrck_o);
                @(negedge lrck_o); @(posedge lrck_o);
                k = k + 1;
                if (k == 98) begin k = 0; blkno = blkno + 1; end
                if (do_stall) begin
                    do_stall = 0;
                    exp_rd = exp_wr;
                    #20000000;
                    disable stream;
                end
            end
        end
    end

    // host model: SCCK burst after EFFK (async), samples SBCP like U31
    reg [7:0] rx;
    always @(posedge effk) begin : host_model
        integer i;
        if (scor === 1'b0) begin
            #151;
            rx = 8'h00;
            for (i = 0; i < 8; i = i + 1) begin
                rx = {rx[6:0], sbcp};
                scck = 1; #150; scck = 0; #129;
            end
            if (exp_rd < exp_wr) begin
                if (rx !== expq[exp_rd % 256]) begin
                    errors = errors + 1;
                    if (errors < 10)
                        $display("FAIL burst @%0t: rx=%02X expected=%02X (exp_rd=%0d)",
                                 $realtime, rx, expq[exp_rd % 256], exp_rd);
                end else
                    checked = checked + 1;
                exp_rd = exp_rd + 1;
            end
        end
    end

    // EFFK / SCOR measurements
    real t_effk_rise = 0, effk_period = 0, effk_width = 0;
    always @(posedge effk) begin
        if (t_effk_rise > 0) effk_period = $realtime - t_effk_rise;
        t_effk_rise = $realtime;
    end
    always @(negedge effk) if (t_effk_rise > 0) effk_width = $realtime - t_effk_rise;

    real t_scor_rise = 0, scor_period = 0, scor_width = 0;
    always @(posedge scor) begin
        if (t_scor_rise > 0) scor_period = $realtime - t_scor_rise;
        t_scor_rise = $realtime;
    end
    always @(negedge scor) if (t_scor_rise > 0) scor_width = $realtime - t_scor_rise;

    task check_near(input real val, input real lo, input real hi, input [255:0] name);
        if (val < lo || val > hi) begin
            errors = errors + 1;
            $display("FAIL %0s: %0.3f us outside [%0.3f, %0.3f]", name,
                     val/1e3, lo/1e3, hi/1e3);
        end else $display("ok   %0s: %0.3f us", name, val/1e3);
    endtask

    integer checked_before_stall;
    initial begin
        #2000 reset_n = 1;

        // steady state: verify byte integrity and EFFK/SCOR timing
        #60000000;
        if (checked < 150) begin
            errors = errors + 1;
            $display("FAIL: only %0d bytes verified at steady state (expected >150)", checked);
        end else $display("ok   %0d bytes verified (data + S0) with no errors so far", checked);

        check_near(effk_period, 135.5e3, 136.6e3, "EFFK period (136.05 us)");
        check_near(effk_width,   67.4e3,  68.6e3, "EFFK high (68.03 us)");
        check_near(scor_period, 13.30e6, 13.37e6, "SCOR period (13.333 ms)");
        check_near(scor_width,  0.130e6, 0.142e6, "SCOR width (136 us)");

        // PIO stall mid-block + resync
        checked_before_stall = checked;
        do_stall = 1;
        #60000000;
        if (checked - checked_before_stall < 100) begin
            errors = errors + 1;
            $display("FAIL: after the stall only %0d bytes verified",
                     checked - checked_before_stall);
        end else
            $display("ok   recovery from the stall: another %0d bytes verified",
                     checked - checked_before_stall);

        if (errors == 0) $display("ALL SUBPW TESTS OK (%0d bytes total)", checked);
        else             $display("%0d ERRORS", errors);
        $finish;
    end
endmodule
